## soc/gd/gd32/gd32f10x/Kconfig.soc
```kconfig
# Copyright (c) 2021 YuLong Yao <feilongphone@gmail.com>
# SPDX-License-Identifier: Apache-2.0

config SOC_SERIES_GD32F10X
	bool
	select SOC_FAMILY_GD_GD32
	help
	  Enable support for GigaDevice GD32F10X MCU series

config SOC_SERIES
	default "gd32f10x" if SOC_SERIES_GD32F10X

config SOC_GD32F103
	bool
	select SOC_SERIES_GD32F10X

config SOC
	default "GD32F10X_MD" if SOC_GD32F103
```
